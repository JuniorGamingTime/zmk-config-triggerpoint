/ {
    matrix_transform0: keymap_transform {
        compatible = "zmk,matrix-transform";
        rows = <5>;
        cols = <12>;

        /* row-major, left (0..29), then right (30..59) */
        map = <
            /* R0 */  0  1  2  3  4  5   30 31 32 33 34 35
            /* R1 */  6  7  8  9 10 11   36 37 38 39 40 41
            /* R2 */ 12 13 14 15 16 17   42 43 44 45 46 47
            /* R3 */ 18 19 20 21 22 23   48 49 50 51 52 53
            /* R4 */ 24 25 26 27 28 29   54 55 56 57 58 59
        >;

        /* Direct keys are appended after matrix: indices 60..63
           (left: Thumb=D0 → 60, Screen=D1 → 61, PotBtn=D4 → 62, right: EncBtn=D4 → 63) */
    };
};
