## boards/shields/trigger_point/Kconfig.defconfig
```kconfig
if SHIELD_TRIGGER_POINT_LEFT || SHIELD_TRIGGER_POINT_RIGHT || SHIELD_TRIGGER_POINT_DONGLE

config ZMK_SPLIT
    default y

config ZMK_SPLIT_BLE
    def_bool y


# Left, Right and Dongle
endif   

if SHIELD_TRIGGER_POINT_DONGLE

config ZMK_KEYBOARD_NAME
    default "Trigger Point"

config ZMK_SPLIT_BLE_CENTRAL_PERIPHERALS
    int
    default 2

config BT_MAX_CONN
    int
    default 3

# Set this to the same number as BT_MAX_CONN
config BT_MAX_PAIRED
    int
    default 4

config ZMK_SPLIT_ROLE_CENTRAL
    default y

config ZMK_USB
    def_bool y

config USB_DEVICE_STACK
    def_bool y

# Dongle central
endif   

if SHIELD_TRIGGER_POINT_LEFT || SHIELD_TRIGGER_POINT_RIGHT

config ZMK_SPLIT_ROLE_PERIPHERAL
    def_bool y

config ZMK_USB
    def_bool n

config USB_DEVICE_STACK
    def_bool n


# Left || Right
endif   
```

## boards/shields/trigger_point/Kconfig.shield
```kconfig
config SHIELD_TRIGGER_POINT_LEFT
    def_bool $(shields_list_contains,trigger_point_left)

config SHIELD_TRIGGER_POINT_RIGHT
    def_bool $(shields_list_contains,trigger_point_right)

config SHIELD_TRIGGER_POINT_DONGLE
    def_bool $(shields_list_contains,trigger_point_dongle)
```

## config/boards/shields/Kconfig.defconfig
```kconfig
if SHIELD_TRIGGERPOINT_LEFT

config ZMK_KEYBOARD_NAME
    default "TriggerPoint"

config ZMK_SPLIT_ROLE_CENTRAL
    default y

endif

if SHIELD_TRIGGERPOINT_LEFT || SHIELD_TRIGGERPOINT_RIGHT

config ZMK_SPLIT
    default y

endif
```

## config/boards/shields/Kconfig.shield
```kconfig
config SHIELD_TRIGGERPOINT_LEFT
    def_bool $(shields_list_contains,triggerpoint_left)

config SHIELD_TRIGGERPOINT_RIGHT
    def_bool $(shields_list_contains,triggerpoint_right)
```
