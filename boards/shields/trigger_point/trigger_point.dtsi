#include <dt-bindings/zmk/matrix_transform.h>

/ {
    default_transform: keymap_transform_0 {
        compatible = "zmk,matrix-transform";
        rows = <5>;
        columns = <12>;
        map = <
            /* row 0 */ 0x000 0x001 0x002 0x003 0x004 0x005   0x006 0x007 0x008 0x009 0x00A 0x00B
            /* row 1 */ 0x100 0x101 0x102 0x103 0x104 0x105   0x106 0x107 0x108 0x109 0x10A 0x10B
            /* row 2 */ 0x200 0x201 0x202 0x203 0x204 0x205   0x206 0x207 0x208 0x209 0x20A 0x20B
            /* row 3 */ 0x300 0x301 0x302 0x303 0x304 0x305   0x306 0x307 0x308 0x309 0x30A 0x30B
            /* row 4 */ 0x400 0x401 0x402 0x403 0x404 0x405   0x406 0x407 0x408 0x409 0x40A 0x40B
        >;
    };
};

