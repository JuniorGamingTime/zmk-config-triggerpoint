#include <dt-bindings/zmk/matrix_transform.h>
#include "trigger_point-pinctrl.dtsi"

/ {
    left_encoder: left_encoder {
        compatible = "alps,ec11";
        steps = <80>;
        status = "disabled";

        a-gpios = <&pro_micro 21 (GPIO_ACTIVE_HIGH | GPIO_PULL_UP)>;
        b-gpios = <&pro_micro 20 (GPIO_ACTIVE_HIGH | GPIO_PULL_UP)>;
    };

    right_encoder: right_encoder {
        compatible = "alps,ec11";
        steps = <80>;
        status = "disabled";

        a-gpios = <&pro_micro 21 (GPIO_ACTIVE_HIGH | GPIO_PULL_UP)>;
        b-gpios = <&pro_micro 20 (GPIO_ACTIVE_HIGH | GPIO_PULL_UP)>;
    };
};
